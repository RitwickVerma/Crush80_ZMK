## zmk/Kconfig
```kconfig
rsource "drivers/usb/Kconfig"
rsource "drivers/bluetooth/Kconfig"
rsource "drivers/sensor/Kconfig"
rsource "drivers/watchdog/Kconfig"
rsource "drivers/led_strip/Kconfig"

config BOOT_DIAG
	bool "Boot diagnostic (.noinit SRAM buffer for SWS debug)"
	default n
	help
	  Records boot stage codes to a .noinit SRAM buffer that can be read
	  via SWS/BDT even when USB is not working.

config BOOT_DIAG_GPIO
	bool "Boot diagnostic GPIO heartbeat (PD7)"
	default y
	depends on BOOT_DIAG
	help
	  Toggle PD7 at each boot stage for logic analyzer visibility.

config FLASH_MGMT
	bool "Raw flash management via mcumgr"
	default n
	depends on MCUMGR && FLASH
	help
	  Adds a custom mcumgr group (ID 64) with raw flash erase/write/read
	  commands. Used to restore original firmware via USB without SWS
	  hardware.

config RAINY_RGB
	bool "Rainy75 out-of-tree RGB lighting engine (ported for Crush80)"
	depends on LED_STRIP_B91_SPI
	help
	  Custom WS2812 lighting engine (effects, reactivity, per-key) that
	  replaces ZMK's rgb_underglow. Owns the led_strip device directly.

config CRUSH80_KEYMAP_REV
	int "Keymap layout revision"
	default 2
	depends on ZMK_KEYMAP_SETTINGS_STORAGE
	help
	  Live edits made in VIA or ZMK Studio are stored per layer number. When the
	  layer list in crush80.keymap changes, raise this: the first boot clears the
	  saved edits so they cannot land on the wrong layers (see keymap_rev.c).

config OPENRGB
	bool "OpenRGB support over Raw HID (QMK OpenRGB protocol v0x0C)"
	depends on RAINY_RGB && USB_DEVICE_HID
	help
	  Adds a second HID interface (HID_1) speaking the QMK OpenRGB Raw HID
	  protocol, so OpenRGB can auto-detect the keyboard and drive each LED
	  directly (per-key color) or switch rainy_rgb effects.  Requires
	  CONFIG_USB_HID_DEVICE_COUNT=2 and the per-instance interrupt-OUT
	  patch to the Zephyr USB HID class.

config VIA
	bool "VIA keymap editing over USB (VIA protocol 12)"
	depends on USB_DEVICE_HID && ZMK_KEYMAP_SETTINGS_STORAGE
	help
	  Adds a third HID interface (HID_2, raw HID 0xFF60/0x61, 32-byte
	  reports) so the VIA configurator can read and edit the live ZMK keymap,
	  the same one ZMK Studio edits. Needs CONFIG_USB_HID_DEVICE_COUNT=3 and
	  the per-instance interrupt-OUT Zephyr patches. See docs/via.md.

config RAINY_RGB_WALKER
	bool "Walker diagnostic effect (LED-map calibration)"
	depends on RAINY_RGB
	default n
	help
	  Appends a "walker" effect that lights one LED and steps to the next
	  chain index on each keypress. Used to calibrate the 154-LED map.

config RAINY_RGB_IDLE_BLANK
	bool "Blank LEDs on activity idle (power saving)"
	depends on RAINY_RGB
	default n
	help
	  Turn the per-key LEDs off after CONFIG_ZMK_IDLE_TIMEOUT of no activity.

config CRUSH80_AUTO_CONFIRM
	bool "Auto-confirm booted image (disable for TEST builds)"
	default y
	depends on IMG_MANAGER && WDT_B91
	help
	  Confirm the booted MCUboot image ~5s after boot (with a watchdog
	  safety net). DISABLE this for TEST builds so a bad image stays in
	  MCUboot "test" mode and reverts to the previous confirmed image on
	  the next power-cycle (unplug/replug).
```

## zmk/dts/bindings/behaviors/crush80,behavior-via-macro.yaml
```yaml
description: Plays a macro stored in the VIA macro buffer (M0-M15 in VIA)
compatible: "crush80,behavior-via-macro"
include: one_param.yaml
```
