/*
 * ZMK Studio over USB CDC ACM (standard ZMK path).
 *
 * The B91's 256 B USB SRAM fits exactly ONE CDC ACM next to the HID
 * interfaces. It is given to ZMK Studio so stock ZMK Studio connects over
 * WebSerial (USB), exactly like any other ZMK board.
 *
 * Firmware updates go through the MCUboot bootloader's own CDC ACM instead:
 * Fn+Esc -> "ZEPHYR MCUBOOT" (2fe3:0100) -> scripts/dfu.py / update.sh.
 */

/ {
	chosen {
		zmk,studio-rpc-uart = &studio_cdc_acm;
	};
};

&zephyr_udc0 {
	studio_cdc_acm: studio_cdc_acm {
		compatible = "zephyr,cdc-acm-uart";
	};
};
