/*
 * OTA bridge only: the single USB CDC ACM carries mcumgr SMP (it is also the
 * chosen console, though no console/log backend is enabled),
 * so install_zmk.sh stage 2 can write ZMK through flash_mgmt. The app build
 * has no serial port at all (conf/app.overlay).
 */

/ {
	chosen {
		zephyr,uart-mcumgr = &mcumgr_cdc_acm;
		zephyr,console = &mcumgr_cdc_acm;
	};
};

&zephyr_udc0 {
	mcumgr_cdc_acm: mcumgr_cdc_acm {
		compatible = "zephyr,cdc-acm-uart";
	};
};
